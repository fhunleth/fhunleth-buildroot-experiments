## Config.in
```kconfig
# Custom packages

source "$BR2_EXTERNAL_FHUNLETH_PATH/package/python-scrollphat/Config.in"
source "$BR2_EXTERNAL_FHUNLETH_PATH/package/sdburner/Config.in"
source "$BR2_EXTERNAL_FHUNLETH_PATH/package/write_file/Config.in"
```

## configs/fstest_defconfig
```kconfig
BR2_aarch64=y
BR2_TOOLCHAIN_EXTERNAL=y
BR2_TOOLCHAIN_EXTERNAL_BOOTLIN=y
BR2_GLOBAL_PATCH_DIR="${BR2_EXTERNAL_FHUNLETH_PATH}/patches"
# BR2_TARGET_GENERIC_REMOUNT_ROOTFS_RW is not set
BR2_ROOTFS_OVERLAY="${BR2_EXTERNAL_FHUNLETH_PATH}/board/fstest/rootfs_overlay"
BR2_LINUX_KERNEL=y
BR2_LINUX_KERNEL_CUSTOM_VERSION=y
BR2_LINUX_KERNEL_CUSTOM_VERSION_VALUE="6.12.27"
BR2_LINUX_KERNEL_USE_CUSTOM_CONFIG=y
BR2_LINUX_KERNEL_CUSTOM_CONFIG_FILE="${BR2_EXTERNAL_FHUNLETH_PATH}/board/fstest/linux.config"
BR2_LINUX_KERNEL_NEEDS_HOST_OPENSSL=y
BR2_PACKAGE_BLKTRACE=y
BR2_PACKAGE_DOSFSTOOLS=y
BR2_PACKAGE_DOSFSTOOLS_MKFS_FAT=y
BR2_PACKAGE_E2FSPROGS=y
BR2_PACKAGE_F2FS_TOOLS=y
BR2_TARGET_ROOTFS_CPIO_ZSTD=y
BR2_TARGET_ROOTFS_INITRAMFS=y
# BR2_TARGET_ROOTFS_TAR is not set
BR2_PACKAGE_WRITE_FILE=y
```

## package/write_file/Config.in
```kconfig
config BR2_PACKAGE_WRITE_FILE
	bool "write_file"
	help
	  write a file in a few ways for experiments
```
