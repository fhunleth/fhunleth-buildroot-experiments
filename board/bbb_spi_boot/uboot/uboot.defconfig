## configs/nerves_vultr_loader_defconfig
```kconfig
BR2_x86_64=y
BR2_TOOLCHAIN_EXTERNAL=y
BR2_TOOLCHAIN_EXTERNAL_CUSTOM=y
BR2_TOOLCHAIN_EXTERNAL_DOWNLOAD=y
BR2_TOOLCHAIN_EXTERNAL_URL="https://github.com/nerves-project/toolchains/releases/download/v0.11.0/nerves_toolchain_x86_64_unknown_linux_gnu-0.11.0.linux-x86_64.tar.xz"
BR2_TOOLCHAIN_EXTERNAL_CUSTOM_PREFIX="$(ARCH)-unknown-linux-gnu"
BR2_TOOLCHAIN_EXTERNAL_GCC_6=y
BR2_TOOLCHAIN_EXTERNAL_HEADERS_4_10=y
BR2_TOOLCHAIN_EXTERNAL_CUSTOM_GLIBC=y
BR2_TOOLCHAIN_EXTERNAL_CXX=y
BR2_TARGET_GENERIC_HOSTNAME="nerves_vultr_loader"
BR2_TARGET_GENERIC_ISSUE=""
BR2_TARGET_GENERIC_GETTY_PORT="tty1"
# BR2_TARGET_GENERIC_REMOUNT_ROOTFS_RW is not set
BR2_ROOTFS_OVERLAY="${BR2_EXTERNAL_FHUNLETH_PATH}/board/nerves_vultr_loader/rootfs-additions"
BR2_ROOTFS_POST_IMAGE_SCRIPT="${BR2_EXTERNAL_FHUNLETH_PATH}/board/nerves_vultr_loader/post-image.sh"
BR2_LINUX_KERNEL=y
BR2_LINUX_KERNEL_USE_CUSTOM_CONFIG=y
BR2_LINUX_KERNEL_CUSTOM_CONFIG_FILE="${BR2_EXTERNAL_FHUNLETH_PATH}/board/nerves_vultr_loader/linux-4.11.config"
BR2_LINUX_KERNEL_XZ=y
BR2_PACKAGE_E2FSPROGS=y
# BR2_PACKAGE_E2FSPROGS_FSCK is not set
BR2_PACKAGE_E2FSPROGS_RESIZE2FS=y
BR2_PACKAGE_FWUP=y
BR2_PACKAGE_PARTED=y
BR2_PACKAGE_OPENSSH=y
BR2_TARGET_ROOTFS_CPIO=y
BR2_TARGET_ROOTFS_CPIO_XZ=y
# BR2_TARGET_ROOTFS_TAR is not set
```

## configs/rpi0_badge_defconfig
```kconfig
BR2_arm=y
BR2_arm1176jzf_s=y
BR2_ARM_EABI=y
BR2_GLOBAL_PATCH_DIR="${BR2_EXTERNAL_FHUNLETH_PATH}/patches"
BR2_TOOLCHAIN_EXTERNAL=y
BR2_TOOLCHAIN_EXTERNAL_CUSTOM=y
BR2_TOOLCHAIN_EXTERNAL_DOWNLOAD=y
BR2_TOOLCHAIN_EXTERNAL_URL="https://github.com/nerves-project/toolchains/releases/download/v1.0.0-rc.0/nerves_toolchain_armv6_rpi_linux_gnueabi-linux_x86_64-1.0.0-rc.0-E8ADE59.tar.xz"
BR2_TOOLCHAIN_EXTERNAL_CUSTOM_PREFIX="armv6-rpi-linux-gnueabi"
BR2_TOOLCHAIN_EXTERNAL_GCC_6=y
BR2_TOOLCHAIN_EXTERNAL_HEADERS_4_1=y
BR2_TOOLCHAIN_EXTERNAL_CUSTOM_GLIBC=y
BR2_TOOLCHAIN_EXTERNAL_CXX=y
BR2_TARGET_GENERIC_HOSTNAME="badge"
BR2_TARGET_GENERIC_ISSUE=""
# BR2_TARGET_ENABLE_ROOT_LOGIN is not set
BR2_TARGET_GENERIC_GETTY_PORT="ttyGS0"
BR2_TARGET_GENERIC_GETTY_BAUDRATE_115200=y
# BR2_TARGET_GENERIC_REMOUNT_ROOTFS_RW is not set
BR2_ENABLE_LOCALE_WHITELIST="locale-archive"
BR2_GENERATE_LOCALE="en_US.UTF-8"
BR2_ROOTFS_OVERLAY="${BR2_EXTERNAL_FHUNLETH_PATH}/board/rpi0_badge/rootfs_overlay"
BR2_ROOTFS_POST_IMAGE_SCRIPT="${BR2_EXTERNAL_FHUNLETH_PATH}/board/rpi0_badge/post-createfs.sh"
BR2_LINUX_KERNEL=y
BR2_LINUX_KERNEL_CUSTOM_GIT=y
BR2_LINUX_KERNEL_CUSTOM_REPO_URL="https://github.com/raspberrypi/linux.git"
BR2_LINUX_KERNEL_CUSTOM_REPO_VERSION="04c8e47067d4873c584395e5cb260b4f170a99ea"
BR2_LINUX_KERNEL_USE_CUSTOM_CONFIG=y
BR2_LINUX_KERNEL_CUSTOM_CONFIG_FILE="${BR2_EXTERNAL_FHUNLETH_PATH}/board/rpi0_badge/linux-4.4.defconfig"
BR2_LINUX_KERNEL_DTS_SUPPORT=y
BR2_LINUX_KERNEL_INTREE_DTS_NAME="bcm2708-rpi-0-w bcm2708-rpi-b-plus"
BR2_PACKAGE_RPI_FIRMWARE=y
BR2_PACKAGE_PYTHON=y
BR2_TARGET_ROOTFS_SQUASHFS=y
# BR2_TARGET_ROOTFS_TAR is not set
BR2_PACKAGE_HOST_FWUP=y
BR2_PACKAGE_PYTHON_SCROLLPHAT=y
```

## configs/rpi0_encrypted_defconfig
```kconfig
BR2_arm=y
BR2_arm1176jzf_s=y
BR2_ARM_EABI=y
BR2_TAR_OPTIONS="--no-same-owner"
BR2_OPTIMIZE_2=y
BR2_GLOBAL_PATCH_DIR="${BR2_EXTERNAL_FHUNLETH_PATH}/patches"
BR2_TOOLCHAIN_EXTERNAL=y
BR2_TOOLCHAIN_EXTERNAL_CUSTOM=y
BR2_TOOLCHAIN_EXTERNAL_DOWNLOAD=y
BR2_TOOLCHAIN_EXTERNAL_URL="https://github.com/nerves-project/toolchains/releases/download/v1.2.0/nerves_toolchain_armv6_rpi_linux_gnueabi-linux_x86_64-1.2.0-0686F5F.tar.xz"
BR2_TOOLCHAIN_EXTERNAL_CUSTOM_PREFIX="armv6-rpi-linux-gnueabi"
BR2_TOOLCHAIN_EXTERNAL_GCC_8=y
BR2_TOOLCHAIN_EXTERNAL_HEADERS_4_4=y
BR2_TOOLCHAIN_EXTERNAL_CUSTOM_GLIBC=y
BR2_TOOLCHAIN_EXTERNAL_CXX=y
BR2_TARGET_GENERIC_HOSTNAME="rpi0_encrypted"
BR2_TARGET_GENERIC_ISSUE=""
BR2_TARGET_GENERIC_ROOT_PASSWD="root"
BR2_TARGET_GENERIC_GETTY_PORT="ttyS0"
BR2_TARGET_GENERIC_GETTY_BAUDRATE_115200=y
# BR2_TARGET_GENERIC_REMOUNT_ROOTFS_RW is not set
BR2_ENABLE_LOCALE_WHITELIST="locale-archive"
BR2_GENERATE_LOCALE="en_US.UTF-8"
BR2_ROOTFS_OVERLAY="${BR2_EXTERNAL_FHUNLETH_PATH}/board/rpi0_encrypted/rootfs_overlay"
BR2_ROOTFS_POST_IMAGE_SCRIPT="${BR2_EXTERNAL_FHUNLETH_PATH}/board/rpi0_encrypted/post-createfs.sh"
BR2_LINUX_KERNEL=y
BR2_LINUX_KERNEL_CUSTOM_TARBALL=y
BR2_LINUX_KERNEL_CUSTOM_TARBALL_LOCATION="$(call github,raspberrypi,linux,raspberrypi-kernel_1.20190925-1)/linux-raspberrypi-kernel_1.20190925-1.tar.gz"
BR2_LINUX_KERNEL_USE_CUSTOM_CONFIG=y
BR2_LINUX_KERNEL_CUSTOM_CONFIG_FILE="${BR2_EXTERNAL_FHUNLETH_PATH}/board/rpi0_encrypted/linux-4.19.defconfig"
BR2_LINUX_KERNEL_XZ=y
BR2_LINUX_KERNEL_DTS_SUPPORT=y
BR2_LINUX_KERNEL_INTREE_DTS_NAME="bcm2708-rpi-zero-w bcm2708-rpi-zero"
BR2_PACKAGE_STRACE=y
BR2_PACKAGE_RPI_FIRMWARE=y
BR2_PACKAGE_CRYPTSETUP=y
BR2_PACKAGE_PYTHON=y
BR2_TARGET_ROOTFS_INITRAMFS=y
BR2_TARGET_ROOTFS_SQUASHFS=y
# BR2_TARGET_ROOTFS_TAR is not set
BR2_PACKAGE_HOST_FWUP=y
```

## configs/rpi2_sdburner_defconfig
```kconfig
BR2_arm=y
BR2_cortex_a7=y
BR2_ARM_FPU_NEON_VFPV4=y
BR2_GLOBAL_PATCH_DIR="${BR2_EXTERNAL_FHUNLETH_PATH}/patches"
BR2_TOOLCHAIN_EXTERNAL=y
BR2_TOOLCHAIN_EXTERNAL_CUSTOM=y
BR2_TOOLCHAIN_EXTERNAL_DOWNLOAD=y
BR2_TOOLCHAIN_EXTERNAL_URL="https://github.com/nerves-project/toolchains/releases/download/v1.0.0/nerves_toolchain_arm_unknown_linux_gnueabihf-linux_x86_64-1.0.0-400FC9B.tar.xz"
BR2_TOOLCHAIN_EXTERNAL_CUSTOM_PREFIX="arm-unknown-linux-gnueabihf"
BR2_TOOLCHAIN_EXTERNAL_GCC_6=y
BR2_TOOLCHAIN_EXTERNAL_HEADERS_4_1=y
BR2_TOOLCHAIN_EXTERNAL_CUSTOM_GLIBC=y
BR2_TOOLCHAIN_EXTERNAL_CXX=y
BR2_TARGET_GENERIC_HOSTNAME="sdburner"
BR2_TARGET_GENERIC_ISSUE=""
BR2_TARGET_GENERIC_GETTY_PORT="ttyAMA0"
BR2_TARGET_GENERIC_GETTY_BAUDRATE_115200=y
# BR2_TARGET_GENERIC_REMOUNT_ROOTFS_RW is not set
BR2_ENABLE_LOCALE_WHITELIST="locale-archive"
BR2_GENERATE_LOCALE="en_US.UTF-8"
BR2_ROOTFS_OVERLAY="${BR2_EXTERNAL_FHUNLETH_PATH}/board/rpi_sdburner/rootfs_overlay"
BR2_ROOTFS_POST_IMAGE_SCRIPT="${BR2_EXTERNAL_FHUNLETH_PATH}/board/rpi_sdburner/post-createfs.sh"
BR2_LINUX_KERNEL=y
BR2_LINUX_KERNEL_CUSTOM_TARBALL=y
BR2_LINUX_KERNEL_CUSTOM_TARBALL_LOCATION="$(call github,raspberrypi,linux,865ddc1393f558198e7e7ce70928ff2e49c4f7f6)/linux-865ddc1393f558198e7e7ce70928ff2e49c4f7f6.tar.gz"
BR2_LINUX_KERNEL_USE_CUSTOM_CONFIG=y
BR2_LINUX_KERNEL_CUSTOM_CONFIG_FILE="${BR2_EXTERNAL_FHUNLETH_PATH}/board/rpi_sdburner/linux-4.14.defconfig"
BR2_LINUX_KERNEL_DTS_SUPPORT=y
BR2_LINUX_KERNEL_INTREE_DTS_NAME="bcm2709-rpi-2-b"
BR2_PACKAGE_DEJAVU=y
# BR2_PACKAGE_DEJAVU_MONO is not set
# BR2_PACKAGE_DEJAVU_SANS_CONDENSED is not set
# BR2_PACKAGE_DEJAVU_SERIF_CONDENSED is not set
BR2_PACKAGE_QT5=y
BR2_PACKAGE_QT5BASE_GUI=y
BR2_PACKAGE_QT5BASE_WIDGETS=y
BR2_PACKAGE_QT5BASE_FONTCONFIG=y
BR2_PACKAGE_QT5BASE_JPEG=y
BR2_PACKAGE_QT5BASE_PNG=y
BR2_PACKAGE_RPI_FIRMWARE=y
BR2_PACKAGE_RPI_FIRMWARE_KERNEL_4_9=y
BR2_PACKAGE_EVTEST=y
BR2_PACKAGE_RNG_TOOLS=y
BR2_TARGET_ROOTFS_SQUASHFS=y
# BR2_TARGET_ROOTFS_TAR is not set
BR2_PACKAGE_HOST_FWUP=y
BR2_PACKAGE_SDBURNER=y
```

## configs/rpi3_nettest_defconfig
```kconfig
BR2_arm=y
BR2_cortex_a53=y
BR2_ARM_FPU_NEON_VFPV4=y
BR2_GLOBAL_PATCH_DIR="${BR2_EXTERNAL_FHUNLETH_PATH}/patches"
BR2_TOOLCHAIN_EXTERNAL=y
BR2_TOOLCHAIN_EXTERNAL_CUSTOM=y
BR2_TOOLCHAIN_EXTERNAL_DOWNLOAD=y
BR2_TOOLCHAIN_EXTERNAL_URL="https://github.com/nerves-project/toolchains/releases/download/v1.3.0/nerves_toolchain_arm_unknown_linux_gnueabihf-linux_x86_64-1.3.0-10EB443.tar.xz"
BR2_TOOLCHAIN_EXTERNAL_CUSTOM_PREFIX="arm-unknown-linux-gnueabihf"
BR2_TOOLCHAIN_EXTERNAL_HEADERS_4_14=y
BR2_TOOLCHAIN_EXTERNAL_CUSTOM_GLIBC=y
BR2_TOOLCHAIN_EXTERNAL_CXX=y
BR2_TARGET_GENERIC_HOSTNAME="nettest"
BR2_TARGET_GENERIC_ISSUE=""
BR2_ROOTFS_DEVICE_TABLE="${BR2_EXTERNAL_FHUNLETH_PATH}/board/rpi3_nettest/device_table.txt"
# BR2_TARGET_GENERIC_GETTY is not set
# BR2_TARGET_GENERIC_REMOUNT_ROOTFS_RW is not set
BR2_SYSTEM_DHCP="eth0"
BR2_ENABLE_LOCALE_WHITELIST="locale-archive"
BR2_GENERATE_LOCALE="en_US.UTF-8"
BR2_ROOTFS_OVERLAY="${BR2_EXTERNAL_FHUNLETH_PATH}/board/rpi3_nettest/rootfs_overlay"
BR2_ROOTFS_POST_IMAGE_SCRIPT="${BR2_EXTERNAL_FHUNLETH_PATH}/board/rpi3_nettest/post-createfs.sh"
BR2_LINUX_KERNEL=y
BR2_LINUX_KERNEL_CUSTOM_TARBALL=y
BR2_LINUX_KERNEL_CUSTOM_TARBALL_LOCATION="$(call github,raspberrypi,linux,raspberrypi-kernel_1.20200212-1)/linux-raspberrypi-kernel_1.20200212-1.tar.gz"
BR2_LINUX_KERNEL_USE_CUSTOM_CONFIG=y
BR2_LINUX_KERNEL_CUSTOM_CONFIG_FILE="${BR2_EXTERNAL_FHUNLETH_PATH}/board/rpi3_nettest/linux-4.19.defconfig"
BR2_LINUX_KERNEL_XZ=y
BR2_LINUX_KERNEL_DTS_SUPPORT=y
BR2_LINUX_KERNEL_INTREE_DTS_NAME="bcm2710-rpi-3-b bcm2710-rpi-cm3 bcm2710-rpi-3-b-plus"
BR2_PACKAGE_BUSYBOX_CONFIG_FRAGMENT_FILES="../board/rpi3_nettest/busybox.fragment"
BR2_PACKAGE_RPI_FIRMWARE=y
BR2_PACKAGE_RPI_FIRMWARE_KERNEL_4_19=y
BR2_PACKAGE_RPI_FIRMWARE_X=y
BR2_PACKAGE_RPI_WIFI_FIRMWARE=y
BR2_PACKAGE_PICOCOM=y
BR2_PACKAGE_USB_MODESWITCH=y
BR2_PACKAGE_IPTABLES=y
BR2_PACKAGE_PPPD=y
BR2_PACKAGE_PPPD_FILTER=y
BR2_PACKAGE_WIRELESS_REGDB=y
BR2_PACKAGE_WPA_SUPPLICANT=y
BR2_PACKAGE_WPA_SUPPLICANT_AP_SUPPORT=y
BR2_PACKAGE_WPA_SUPPLICANT_AUTOSCAN=y
BR2_PACKAGE_WPA_SUPPLICANT_EAP=y
BR2_PACKAGE_WPA_SUPPLICANT_HOTSPOT=y
BR2_PACKAGE_WPA_SUPPLICANT_DEBUG_SYSLOG=y
BR2_PACKAGE_WPA_SUPPLICANT_WPS=y
BR2_PACKAGE_WPA_SUPPLICANT_CLI=y
BR2_PACKAGE_WPA_SUPPLICANT_PASSPHRASE=y
BR2_TARGET_ROOTFS_EXT2=y
BR2_TARGET_ROOTFS_EXT2_4=y
BR2_TARGET_ROOTFS_EXT2_SIZE="64M"
# BR2_TARGET_ROOTFS_TAR is not set
BR2_PACKAGE_HOST_FWUP=y
```

## configs/up_board_defconfig
```kconfig
BR2_x86_64=y
BR2_x86_atom=y
BR2_OPTIMIZE_2=y
BR2_TOOLCHAIN_EXTERNAL=y
BR2_TOOLCHAIN_EXTERNAL_DOWNLOAD=y
BR2_TOOLCHAIN_EXTERNAL_URL="https://github.com/nerves-project/toolchains/releases/download/v1.2.0/nerves_toolchain_x86_64_unknown_linux_gnu-linux_x86_64-1.2.0-0A130A6.tar.xz"
BR2_TOOLCHAIN_EXTERNAL_CUSTOM_PREFIX="$(ARCH)-unknown-linux-gnu"
BR2_TOOLCHAIN_EXTERNAL_GCC_8=y
BR2_TOOLCHAIN_EXTERNAL_HEADERS_4_4=y
BR2_TOOLCHAIN_EXTERNAL_CUSTOM_GLIBC=y
BR2_TOOLCHAIN_EXTERNAL_CXX=y
BR2_TARGET_GENERIC_GETTY_PORT="tty1"
BR2_ROOTFS_OVERLAY="${BR2_EXTERNAL_FHUNLETH_PATH}/board/up_board/rootfs_overlay"
BR2_ROOTFS_POST_IMAGE_SCRIPT="${BR2_EXTERNAL_FHUNLETH_PATH}/board/up_board/post-image.sh"
BR2_LINUX_KERNEL=y
BR2_LINUX_KERNEL_CUSTOM_VERSION=y
BR2_LINUX_KERNEL_CUSTOM_VERSION_VALUE="4.14.151"
BR2_LINUX_KERNEL_PATCH="${BR2_EXTERNAL_FHUNLETH_PATH}/board/up_board/linux"
BR2_LINUX_KERNEL_USE_CUSTOM_CONFIG=y
BR2_LINUX_KERNEL_CUSTOM_CONFIG_FILE="${BR2_EXTERNAL_FHUNLETH_PATH}/board/up_board/linux.config"
BR2_LINUX_KERNEL_XZ=y
BR2_LINUX_KERNEL_NEEDS_HOST_OPENSSL=y
BR2_LINUX_KERNEL_NEEDS_HOST_LIBELF=y
BR2_PACKAGE_FWUP=y
BR2_PACKAGE_LINUX_FIRMWARE=y
BR2_PACKAGE_INTEL_MICROCODE=y
# BR2_PACKAGE_IFUPDOWN_SCRIPTS is not set
BR2_PACKAGE_EFIBOOTMGR=y
BR2_TARGET_ROOTFS_INITRAMFS=y
# BR2_TARGET_ROOTFS_TAR is not set
BR2_PACKAGE_HOST_FWUP=y
```

## package/fbtft_tools/Config.in
```kconfig
config BR2_PACKAGE_FBTFT_TOOLS
	bool "fbtft_tools"
	depends on BR2_LINUX_KERNEL
	help
	  Helpful kernel modules for Raspberry Pi PiTFT LCDs.

	  https://github.com/notro/fbtft_tools

if BR2_PACKAGE_FBTFT_TOOLS

config BR2_PACKAGE_FBTFT_TOOLS_ADS7846_DEVICE
	bool "ads7846_device"
	help
	  ads7846_device is a kernel module for registering an ads7846
	  device.

	  https://github.com/notro/fbtft_tools/wiki/ads7846_device

config BR2_PACKAGE_FBTFT_TOOLS_GPIO_BACKLIGHT_DEVICE
	bool "gpio_backlight_device"

config BR2_PACKAGE_FBTFT_TOOLS_GPIO_KEYS_DEVICE
	bool "gpio_keys_device"
	help
	  gpio_keys_device is a kernel module for registering a gpio_keys
	  device.

	  https://github.com/notro/fbtft_tools/wiki/gpio_keys_device

config BR2_PACKAGE_FBTFT_TOOLS_GPIO_MOUSE_DEVICE
	bool "gpio_mouse_device"
	help
	  gpio_mouse_device is a kernel module for registering a gpio_mouse
	  device.

	  https://github.com/notro/fbtft_tools/wiki/gpio_mouse_device

config BR2_PACKAGE_FBTFT_TOOLS_RPI_POWER_SWITCH_DEVICE
	bool "rpi_power_switch"

config BR2_PACKAGE_FBTFT_TOOLS_STMPE_DEVICE
	bool "stmpe_device"
	help
	  smtpe_device is a kernel module for registering an stmpe device.

	  https://github.com/notro/fbtft_tools/wiki/stmpe_device

endif # BR2_PACKAGE_FBTFT_TOOLS

comment "fbtft_tools needs a Linux kernel to be built"
	depends on !BR2_LINUX_KERNEL
```

## package/python-scrollphat/Config.in
```kconfig
config BR2_PACKAGE_PYTHON_SCROLLPHAT
	bool "python-scrollphat"
	select BR2_PACKAGE_PYTHON_SMBUS_CFFI
	select BR2_PACKAGE_PYTHON_ZLIB
	help
	  A Python module for the Scroll pHAT. 11x5 LEDs of goodness!

	  https://github.com/pimoroni/scroll-phat
```

## package/sdburner/Config.in
```kconfig
config BR2_PACKAGE_SDBURNER
        depends on BR2_PACKAGE_QT5
        select BR2_PACKAGE_FWUP
	bool "sdburner"
	help
	  Build the SDBurner application
```
